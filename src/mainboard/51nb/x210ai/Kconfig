## src/mainboard/51nb/x210ai/Kconfig
```kconfig
## SPDX-License-Identifier: GPL-2.0-only

if BOARD_51NB_X210AI

config BOARD_SPECIFIC_OPTIONS
	def_bool y
	select BOARD_ROMSIZE_KB_32768
	select DRIVERS_INTEL_PMC
	select FSP_TYPE_IOT
	select HAVE_ACPI_RESUME
	select HAVE_ACPI_TABLES
	select INTEL_GMA_HAVE_VBT
	select INTEL_LPSS_UART_FOR_CONSOLE
	select NO_UART_ON_SUPERIO
	select PMC_IPC_ACPI_INTERFACE
	select SOC_INTEL_COMMON_BLOCK_HDA_VERB
	select SOC_INTEL_ENABLE_USB4_PCIE_RESOURCES
	select SOC_INTEL_METEORLAKE_U_H
	select SPD_READ_BY_WORD
	select SYSTEM_TYPE_LAPTOP

config MAINBOARD_DIR
	default "51nb/x210ai"

config MAINBOARD_PART_NUMBER
	default "X210AI"

config CONSOLE_POST
	default y

config DIMM_SPD_SIZE
	default 1024

config FMDFILE
	default "src/mainboard/\$(CONFIG_MAINBOARD_DIR)/board.fmd"

config UART_FOR_CONSOLE
	default 0

config USE_PM_ACPI_TIMER
	default n

# Retain the memory encryption key across warm resets for S3 resume.
config TME_KEY_REGENERATION_ON_WARM_BOOT
	default n

endif
```
